## nemu/configs/riscv32-nemu_defconfig
```kconfig
CONFIG_ISA_riscv=y
CONFIG_ENGINE_INTERPRETER=y
CONFIG_MODE_SYSTEM=y
CONFIG_TARGET_NATIVE_ELF=y
CONFIG_CC_GCC=y
CONFIG_CC_O2=y
CONFIG_TRACE=y
CONFIG_ITRACE=y
CONFIG_FTRACE=y
CONFIG_WATCHPOINT=y
CONFIG_DEVICE=y
CONFIG_HAS_SERIAL=y
CONFIG_HAS_TIMER=y
CONFIG_HAS_KEYBOARD=y
CONFIG_HAS_VGA=y
CONFIG_RT_CHECK=y
CONFIG_TIMER_GETTIMEOFDAY=y
```
